## c/readv/Kconfig
```kconfig
mainmenu "example"

config BUILD_DEBUG
    bool "Build with -DDEBUG"
    default n

menuconfig OPTIMIZE
    bool "Enable optimization compile flags"
    default y

choice 
    prompt "Optimization"
    depends on OPTIMIZE
    config OPTIMIZE_SMALL
        bool "-Os"
    config OPTIMIZE_DEBUG
        bool "-Og -g3"
endchoice

config FILE_BUF_LEN
    int "file read buffer size"
    default 4096
```
